## board/rk3288/defconfig
```kconfig
# Arch
CONFIG_ARCH_ARM=y

# Board
CONFIG_BOARD="rk3288"

# Image
CONFIG_BASE_ADDRESS=0x43000000
CONFIG_FMAP_OFFSET=0x00100000
CONFIG_HEAP_SIZE=0x01000000
CONFIG_KERNEL_START=0x42000000

# Vboot
CONFIG_EC_SOFTWARE_SYNC=y
CONFIG_RO_NORMAL_SUPPORT=y
CONFIG_VIRTUAL_DEV_SWITCH=y

CONFIG_CROSSYSTEM_FDT=y
CONFIG_NV_STORAGE_CROS_EC=y


CONFIG_MOCK_TPM=y

# Kernel format
CONFIG_KERNEL_FIT=y
CONFIG_KERNEL_FIT_COMPAT="google,snow"
CONFIG_KERNEL_FIT_FDT_ADDR=0x5ff00000

# Drivers
CONFIG_DRIVER_BUS_I2C_S3C24X0=y
CONFIG_DRIVER_BUS_I2S_EXYNOS5=y
CONFIG_DRIVER_BUS_SPI_EXYNOS5=y
CONFIG_DRIVER_EC_CROS=y
CONFIG_DRIVER_EC_CROS_I2C=y
CONFIG_DRIVER_FLASH_SPI=y
CONFIG_DRIVER_GPIO_EXYNOS5250=y
CONFIG_DRIVER_INPUT_MKBP=y
CONFIG_DRIVER_INPUT_MKBP_KEYMATRIX_SNOW=y
CONFIG_DRIVER_INPUT_USB=y
CONFIG_DRIVER_NET_ASIX=y
CONFIG_DRIVER_POWER_EXYNOS=y
CONFIG_DRIVER_SERIAL_ROCKCHIP=y
CONFIG_DRIVER_SOUND_I2S=y
CONFIG_DRIVER_SOUND_MAX98095=y
CONFIG_DRIVER_SOUND_ROUTE=y
CONFIG_DRIVER_STORAGE_MMC=y
CONFIG_DRIVER_STORAGE_MMC_ROCKCHIP=y
CONFIG_DRIVER_TIMER_ROCKCHIP=y
CONFIG_DRIVER_TIMER_ROCKCHIP_ADDRESS=0xFF6B0000
CONFIG_DRIVER_TIMER_ROCKCHIP_HZ=24000000
CONFIG_DRIVER_TPM_SLB9635_I2C=y
CONFIG_DRIVER_VIDEO_EXYNOS5=y
CONFIG_DRIVER_VIDEO_EXYNOS5_BASE=0x14400000
```

## board/veyron/defconfig
```kconfig
# Arch
CONFIG_ARCH_ARM=y

# Board
CONFIG_BOARD="veyron"

# Image
CONFIG_BASE_ADDRESS=0x43000000
CONFIG_FMAP_OFFSET=0x00100000
CONFIG_HEAP_SIZE=0x01000000
CONFIG_KERNEL_START=0x2000000

# Vboot
#CONFIG_EC_SOFTWARE_SYNC=y
CONFIG_RO_NORMAL_SUPPORT=y
CONFIG_VIRTUAL_DEV_SWITCH=y

CONFIG_CROSSYSTEM_FDT=y
#CONFIG_NV_STORAGE_CROS_EC=y


CONFIG_MOCK_TPM=y

# Kernel format
CONFIG_KERNEL_FIT=y
CONFIG_KERNEL_FIT_COMPAT="rockchip,veyron"
CONFIG_KERNEL_FIT_FDT_ADDR=0x6400000

# Drivers
CONFIG_DRIVER_BUS_I2C_RK3288=y
CONFIG_DRIVER_BUS_I2S_EXYNOS5=y
CONFIG_DRIVER_BUS_SPI_EXYNOS5=y
#CONFIG_DRIVER_EC_CROS=y
#CONFIG_DRIVER_EC_CROS_I2C=y
CONFIG_DRIVER_FLASH_SPI=y
CONFIG_DRIVER_GPIO_RK3288=y
#CONFIG_DRIVER_INPUT_MKBP=y
#CONFIG_DRIVER_INPUT_MKBP_KEYMATRIX_STANDARD=y
CONFIG_DRIVER_INPUT_USB=y
CONFIG_DRIVER_NET_ASIX=y
CONFIG_DRIVER_POWER_EXYNOS=y
CONFIG_DRIVER_SOUND_I2S=y
CONFIG_DRIVER_SOUND_MAX98095=y
CONFIG_DRIVER_SOUND_ROUTE=y
CONFIG_DRIVER_STORAGE_MMC=y
CONFIG_DRIVER_STORAGE_MMC_ROCKCHIP=y
CONFIG_DRIVER_TPM_SLB9635_I2C=y
CONFIG_DRIVER_VIDEO_EXYNOS5=y
CONFIG_DRIVER_VIDEO_EXYNOS5_BASE=0x14400000
```
